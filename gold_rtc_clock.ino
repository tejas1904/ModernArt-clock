//created by Tejas S may 2018(date of initial creation) Arduino nano

// this is a project where i make a digital RTC clock using an oled screen and ds3231 
// i have used the U8g library for he oled display
// i have commented many lines of code so that it is easier to understand :)

//Features
//-> displays hours and minutes
//-> 12 hr format
//-> interactive seconds amimation with seconds along with reading
//-> Multiple Screens
//-> Active Room temperature reading
//-> Date and time display

// I have worked hard on this project if you want to use this project anywhere else you can do so without my permission but please do mention my name and github link


//FUTURE UPDATES PLAN
  
// add an Four button menue system to change am and pm format and eaier change in Date and time


//Here is the wiring if you want to test it out or make one yourself
//left button to pin d3 and ground
//right button to pin d2 and ground
// oled screen and DS3231 To respective I2C Pins



#include<DS3231.h>
#include "U8glib.h"

DS3231 rtc(SDA,SCL);

U8GLIB_SSD1306_128X64 u8g(U8G_I2C_OPT_DEV_0|U8G_I2C_OPT_NO_ACK|U8G_I2C_OPT_FAST);                    // Fast I2C / TWI 

                                                                                                    //A Bitmap Image For Thermometer Character 
const uint8_t therm[] PROGMEM  = {
0x00, 0x00, 0x01, 0xF0, 0x00, 0x00, 0x00, 0x00, 0x00, 0x07, 0xFC, 0x00, 0x00, 0x00, 0x00, 0x00,
0x0F, 0xFE, 0x00, 0x00, 0x00, 0x00, 0x00, 0x1F, 0xFF, 0x00, 0x00, 0x00, 0x00, 0x00, 0x1F, 0x1F,
0x00, 0x00, 0x00, 0x00, 0x00, 0x3E, 0x0F, 0x80, 0x00, 0x00, 0x00, 0x00, 0x3C, 0x07, 0x87, 0xFC,
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0x1A, 0x99, 0xC5, 0x0B, 0xA1, 0x6A, 0xD4, 0x85, 0x0A, 0x54, 0xCA, 0x27, 0xAD, 0x9A, 0xA1, 0x67
};

                                                                                                      //Bitmap Image For Calander Image
const uint8_t calender[] PROGMEM  = {
  0x00, 0x00, 0x00, 0x0C, 0x03, 0x00, 0x1F, 0xFF, 0x80, 0x3F, 0xFF, 0xC0, 0x3F, 0xFF, 0xC0, 0x3F,
0xFF, 0xC0, 0x3F, 0xFF, 0xC0, 0x3F, 0xFF, 0xC0, 0x20, 0x00, 0x40, 0x2D, 0xEF, 0x40, 0x2D, 0xEF,
0x40, 0x20, 0x00, 0x40, 0x2D, 0xEF, 0x40, 0x2D, 0xEF, 0x40, 0x2D, 0xEF, 0x40, 0x2D, 0xEF, 0x40,
0x20, 0x00, 0x40, 0x30, 0x00, 0xC0, 0x1F, 0xFF, 0x80, 0x00, 0x00, 0x00,  
};


Time t;
char* s;        
char temp[5];
int seco;
int hours;

bool previousstate=LOW,previousstate2=LOW;
bool state1,state2;
int menue=1;

void setup() {

 
  rtc.begin();
   pinMode(2, INPUT_PULLUP);                                      //activating pullup resistor so that buttons can be wired simpler
 pinMode(3, INPUT_PULLUP);
  
  }

void loop() {

   checkRightButtonPressed();
   checkLeftButtonPressed();
   
   u8g.firstPage();  
  do {
    if(menue==1)
    {draw1();}
    else if(menue==2) 
   { draw2();}
   else if(menue==3) 
   { draw3();}
  
  }
  while( u8g.nextPage() );
  
  delay(50);
  
  }


  
  
  
  
  void draw1() {
  t=rtc.getTime();
  
   u8g.drawCircle(110,32,14);  
  u8g.drawCircle(110,32,14.5);
  u8g.drawCircle(110,32,15);
  u8g.drawFrame(109,32,12,2);//Drawing minute/ long hand
  u8g.drawFrame(109,24,2,9); //Drawing hour/ short hand
  
                                                                     //displaying hrs and min 
  hours=t.hour;

                                                                    //Reading the time and deciding weather to displayam or pm on display
  u8g.setFont(u8g_font_freedoomr10r);
  if(hours>=12)//pm
  { u8g.drawStr(95,14,"P");
    u8g.drawStr(104,14,"M");}
   else if(hours<12)//pm
  {  u8g.drawStr(95,14,"A");
     u8g.drawStr(104,14,"M");}
  

                                                                   // converting Read 24 hr format to 12 hr format
  if(hours>12)
  hours=hours-12;
 
  //displaying hrs and minutes 
  if(hours<10)
  {
  u8g.setFont(u8g_font_freedoomr25n);
  u8g.setPrintPos(0,32); 
  u8g.print('0');
  u8g.setPrintPos(19,32); 
  u8g.print(hours);
  u8g.setPrintPos(38,32); 
  u8g.print(":");
  u8g.setPrintPos(51,32); 
  u8g.print(t.min);
  }

  if(hours>9)
  {
    u8g.setFont(u8g_font_freedoomr25n);
  u8g.setPrintPos(0,32); 
  u8g.print(hours);
  u8g.setPrintPos(39,32); 
  u8g.print(":");
  u8g.setPrintPos(52,32); 
  u8g.print(t.min);
  }
  
  
  //displaying seconds
   u8g.setFont(u8g_font_freedoomr10r);
   s=rtc.getTimeStr();
   u8g.drawStr( -38,58,s);

                                                                    // seconds animation for one second 
                                                   // length of the box is 46 pixels hence for increase in one second of time 1.16 % of the box gets filled
  u8g.drawFrame(20,45,71,11);
    t=rtc.getTime();

    seco=t.sec;
     u8g.drawBox(20,46,(seco*1.16),9);
     
 }

 


    void draw2()
    {
                                                             //Bitmap image of Thermometer being displayed
      u8g.drawBitmapP( 0, 0,7.25,64, therm);

                                                            //displaying temperature
      u8g.setFont(u8g_font_fur20n);
       u8g.setPrintPos(55, 40); 
       u8g.print(rtc.getTemp());
       u8g.setFont(u8g_font_freedoomr10r);
       u8g.drawStr(108,15,"*C");
       
        
      
    
    }

    void draw3()
    {
                                                           //Bitmap image if calander being displayed
        u8g.drawBitmapP( 90, 46,3,20,calender);
        u8g.setFont(u8g_font_fur17);

                                                          //Dispaying the date
        u8g.drawStr(0,20,rtc.getDOWStr());
        u8g.drawStr(0,45,rtc.getDateStr());
    
    }


 void checkRightButtonPressed()
  { 
    
    state1=digitalRead(2);
   if (state1 !=previousstate) 
   previousstate = state1;
  
    if (state1 == 0)
    {if(menue<3) 
      menue++;

      else menue=1;
    }
    
    
   }

void checkLeftButtonPressed()
  {
    state2=digitalRead(3);
    if(state2!=previousstate2)
    previousstate2=state2;
    
      if(state2==0)
     {
      if(menue>1)
      menue--;
    else menue=3;
    }
  }


  
